## sdkconfig.defaults
```kconfig
# ESP32-S3 specific
CONFIG_IDF_TARGET="esp32s3"
CONFIG_ESPTOOLPY_FLASHSIZE_16MB=y
CONFIG_PARTITION_TABLE_CUSTOM=y
CONFIG_PARTITION_TABLE_CUSTOM_FILENAME="partitions.csv"
CONFIG_PARTITION_TABLE_FILENAME="partitions.csv"
CONFIG_SPIRAM=y
CONFIG_SPIRAM_MODE_OCT=y
CONFIG_SPIRAM_SPEED_80M=y
CONFIG_SPIRAM_FETCH_INSTRUCTIONS=y
CONFIG_SPIRAM_RODATA=y
CONFIG_ESP_DEFAULT_CPU_FREQ_MHZ_240=y
CONFIG_ESP_DEFAULT_CPU_FREQ_MHZ=240
CONFIG_ESP_TASK_WDT_TIMEOUT_S=15

# Increase main task stack size for LVGL
CONFIG_ESP_MAIN_TASK_STACK_SIZE=8192

# LVGL Configuration
CONFIG_LV_USE_USER_DATA=y
CONFIG_LV_COLOR_DEPTH_16=y
CONFIG_LV_COLOR_16_SWAP=n
CONFIG_LV_MEM_CUSTOM=y
CONFIG_LV_MEM_CUSTOM_INCLUDE=<stdlib.h>   /*Header for the dynamic memory function*/
#CONFIG_LV_MEM_CUSTOM_ALLOC=malloc
#CONFIG_LV_MEM_CUSTOM_FREE=free
#CONFIG_LV_MEM_CUSTOM_REALLOC=realloc
#CONFIG_LV_TICK_CUSTOM=y
#CONFIG_LV_TICK_CUSTOM_INCLUDE="esp_timer.h"
#CONFIG_LV_TICK_CUSTOM_SYS_TIME_EXPR=((esp_timer_get_time() / 1000LL))

CONFIG_LV_FONT_MONTSERRAT_16=y
CONFIG_LV_FONT_MONTSERRAT_18=y
CONFIG_LV_FONT_MONTSERRAT_20=y
CONFIG_LV_FONT_MONTSERRAT_22=y
CONFIG_LV_FONT_MONTSERRAT_24=y
CONFIG_LV_FONT_MONTSERRAT_26=y
```
